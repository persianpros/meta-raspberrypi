## conf/layer.conf
```bitbake
# We have a conf and classes directory, append to BBPATH
BBPATH .= ":${LAYERDIR}"

# We have a recipes directory containing .bb and .bbappend files, add to BBFILES
BBFILES += "${LAYERDIR}/recipes-*/*.bb ${LAYERDIR}/recipes-*/*.bbappend \
            ${LAYERDIR}/recipes-*/*/*.bb ${LAYERDIR}/recipes-*/*/*.bbappend \
            ${LAYERDIR}/recipes-*/*/*/*.bb ${LAYERDIR}/recipes-*/*/*/*.bbappend"

METARPI_BASE := '${@os.path.normpath("${LAYERDIR}/../")}'
# Prevent current directory creeping into sstate objects. Otherwise, building
# in another TOPDIR will cause recipes using this variable to be rebuilt.
METARPI_BASE[vardepvalue] = 'meta-rpi'

# Additional license directories.
LICENSE_PATH += "${LAYERDIR}/conf/license"
```

## conf/machine/include/rpi-base.inc
```bitbake
KERNELVERSION = "5.4.81"

BOX_BRAND = "rpi"

PREFERRED_PROVIDER_virtual/kernel = "linux-raspberrypi"
PREFERRED_VERSION_linux-raspberrypi = "5.4.%"
PREFERRED_PROVIDER_virtual/egl = "userland"
PREFERRED_PROVIDER_virtual/libgles2 = "userland"
PREFERRED_PROVIDER_jpeg = "jpeg"
PREFERRED_PROVIDER_virtual/libomxil = "userland"
VIRTUAL-RUNTIME_libomxil = "userland"

HDMI_IGNORE_EDID = "0xa5000080"
DISABLE_OVERSCAN = "1"
HDMI_DRIVE = "2"
HDMI_FORCE_HOTPLUG = "1"
SDTV_MODE = "2"
SDTV_ASPECT = "3"
DISABLE_FW_KMS = "1"

IMAGE_CLASSES += "sdcard_image-rpi"

SOC_FAMILY = "rpi"
require conf/machine/include/soc-family.inc

IMAGE_FSTYPES = "rpi-sdimg"
WKS_FILE = "sdimage-raspberrypi.wks"

MACHINE_ESSENTIAL_EXTRA_RDEPENDS += "\
	gstreamer1.0-plugins-bad-fbdevsink \
	kernel-module-e2-procfs \
	kernel-module-dvbsoftwareca \
	kernel-modules \
	rpi-dvb-modules-e2procfs \
	rpi-dvbsoftwareca \
	rpi-firmwares \
	${@bb.utils.contains("MACHINE_FEATURES", "nolcd", "", "enigma2-plugin-extensions-lcd4linux", d)} \
	libcec \
	lirc \
	lirc-plugins \
	udev-rules-rpi \
	"

KERNEL_MODULE_AUTOLOAD += "\
	brcmfmac \
	bcm2835-v4l2 \
	em28xx-v4l \
	dvb-core \
	dvb-usb \
	spi-bcm2835 \
	gpio-ir-tx \
	gpio-ir-recv \
	"

# Help: https://github.com/raspberrypi/firmware/blob/master/boot/overlays/README

RPI_KERNEL_DEVICETREE_OVERLAYS = "\
	overlays/disable-bt.dtbo \
	overlays/dwc2.dtbo \
	overlays/gpio-key.dtbo \
	overlays/i2c-rtc.dtbo \
	overlays/miniuart-bt.dtbo \
	overlays/mcp2515-can0.dtbo \
	overlays/mcp2515-can1.dtbo \
	overlays/pps-gpio.dtbo \
	overlays/rpi-ft5406.dtbo \
	overlays/rpi-poe.dtbo \
	overlays/w1-gpio-pullup.dtbo \
	overlays/w1-gpio.dtbo \
	overlays/gpio-ir-tx.dtbo \
	overlays/gpio-ir.dtbo \
	overlays/rpi-tv.dtbo \
	overlays/gpio-fan.dtbo \
	"

KERNEL_DEVICETREE = "\
	${RPI_KERNEL_DEVICETREE} \
	${RPI_KERNEL_DEVICETREE_OVERLAYS} \
	"

# By default:
#
# * When u-boot is disabled use the "Image" format which can be directly loaded
#   by the rpi firmware.
KERNEL_IMAGETYPE_DIRECT = "zImage"
KERNEL_IMAGETYPE = "zImage"

MACHINE_FEATURES += "apm usbhost keyboard vfat ext2 alsa bluetooth sdio satip rpi-vision HDMI"

# Raspberry Pi has no hardware clock
MACHINE_FEATURES_BACKFILL_CONSIDERED += "rtc"

SERIAL_CONSOLES_CHECK ??= "${SERIAL_CONSOLES}"

# The name of the deploy directory for raspberry pi boot files.
# This variable is referred to by recipes fetching / generating the files.
BOOTFILES_DIR_NAME = "rpi-bootfiles"

# Set Raspberrypi splash image
SPLASH = "psplash-raspberrypi"

def make_dtb_boot_files(d):
    # Generate IMAGE_BOOT_FILES entries for device tree files listed in
    # KERNEL_DEVICETREE.
    alldtbs = d.getVar('KERNEL_DEVICETREE')
    imgtyp = d.getVar('KERNEL_IMAGETYPE')

    def transform(dtb):
        base = os.path.basename(dtb)
        if dtb.endswith('dtb'):
            # eg: whatever/bcm2708-rpi-b.dtb has:
            #     DEPLOYDIR file: bcm2708-rpi-b.dtb
            #     destination: bcm2708-rpi-b.dtb
            return base
        elif dtb.endswith('dtbo'):
            # overlay dtb:
            # eg: overlays/hifiberry-amp.dtbo has:
            #     DEPLOYDIR file: hifiberry-amp.dtbo
            #     destination: overlays/hifiberry-amp.dtbo
            return '{};{}'.format(base, dtb)
        return ''
    return ' '.join([transform(dtb) for dtb in alldtbs.split(' ') if dtb])

IMAGE_BOOT_FILES = "${BOOTFILES_DIR_NAME}/* \
                 ${@make_dtb_boot_files(d)} \
                 ${KERNEL_IMAGETYPE};${SDIMG_KERNELIMAGE} \
                 "

do_image_wic[depends] += "\
    ${BOOTFILES_DIR_NAME}:do_deploy \
    "

IMAGE_CMD_prepend = "\
	rm -Rf ${IMAGE_ROOTFS}/tmp/*; \
	"

do_image_wic[recrdeps] = "do_build"

# The kernel image is installed into the FAT32 boot partition and does not need
# to also be installed into the rootfs.
RDEPENDS_${KERNEL_PACKAGE_NAME}-base = ""
```

## conf/machine/raspberrypi-cm.conf
```bitbake
#@TYPE: Machine
#@NAME: RaspberryPi Compute Module (CM1)
#@DESCRIPTION: Machine configuration for the RaspberryPi Compute Module (CM1)

# Set this early so it overrides rpi-default-versions.inc
PREFERRED_VERSION_linux-raspberrypi ?= "4.9.%"

MACHINEOVERRIDES = "raspberrypi:${MACHINE}"
include conf/machine/raspberrypi.conf
```

## conf/machine/raspberrypi-cm3.conf
```bitbake
#@TYPE: Machine
#@NAME: RaspberryPi Compute Module 3 (CM3)
#@DESCRIPTION: Machine configuration for the RaspberryPi Compute Module 3 (CM3)

# Set this early so it overrides rpi-default-versions.inc
PREFERRED_VERSION_linux-raspberrypi ?= "4.9.%"

MACHINEOVERRIDES = "raspberrypi2:${MACHINE}"
include conf/machine/raspberrypi2.conf
```

## conf/machine/raspberrypi.conf
```bitbake
#@TYPE: Machine
#@NAME: RaspberryPi 1 Development Board
#@DESCRIPTION: Machine configuration for the RaspberryPi 1

DEFAULTTUNE = "arm1176jzfshf"

RPICHIPSET = "BCM2835"

require conf/machine/include/tune-arm1176jzf-s.inc
require conf/machine/include/rpi-base.inc

SDIMG_KERNELIMAGE = "kernel.img"

SERIAL_CONSOLES = "115200;ttyAMA0"

# Check https://github.com/raspberrypi/firmware/tree/master/boot

RPI_KERNEL_DEVICETREE = "\
	bcm2708-rpi-b.dtb \
	bcm2708-rpi-b-plus.dtb \
	bcm2708-rpi-b-rev1.dtb \
	"

RPI_KERNEL_DEVICETREE_OVERLAYS += "\
	overlays/dwc-otg.dtbo \
	"

DVBMEDIASINK_CONFIG = "--with-wmv --with-pcm --with-eac3 --with-dtsdownmix"

MACHINE_FEATURES += "nolcd RCA"

PREFERRED_VERSION_libvpx = "1.6.0"
```

## conf/machine/raspberrypi0.conf
```bitbake
#@TYPE: Machine
#@NAME: RaspberryPi 0 Development Board
#@DESCRIPTION: Machine configuration for the RaspberryPi 0

DEFAULTTUNE = "arm1176jzfshf"

RPICHIPSET = "BCM2835"

require conf/machine/include/tune-arm1176jzf-s.inc
require conf/machine/include/rpi-base.inc

SDIMG_KERNELIMAGE = "kernel.img"

SERIAL_CONSOLES = "115200;ttyS0"

# Check https://github.com/raspberrypi/firmware/tree/master/boot

RPI_KERNEL_DEVICETREE = "\
	bcm2708-rpi-zero-w.dtb \
	bcm2708-rpi-zero.dtb \
	"

DVBMEDIASINK_CONFIG = "--with-wmv --with-pcm --with-eac3 --with-dtsdownmix"

MACHINE_FEATURES += "nolcd"

PREFERRED_VERSION_libvpx = "1.6.0"
```

## conf/machine/raspberrypi2.conf
```bitbake
#@TYPE: Machine
#@NAME: RaspberryPi 2 Development Board
#@DESCRIPTION: Machine configuration for the RaspberryPi 2

DEFAULTTUNE = "cortexa7thf-neon-vfpv4"

RPICHIPSET = "BCM2836"

require conf/machine/include/tune-cortexa7.inc
require conf/machine/include/rpi-base.inc

SDIMG_KERNELIMAGE = "kernel7.img"

SERIAL_CONSOLES = "115200;ttyAMA0"

# Check https://github.com/raspberrypi/firmware/tree/master/boot

RPI_KERNEL_DEVICETREE = "\
	bcm2709-rpi-2-b.dtb \
	bcm2710-rpi-2-b.dtb \
	"

RPI_KERNEL_DEVICETREE_OVERLAYS += "\
	overlays/dwc-otg.dtbo \
	"

DVBMEDIASINK_CONFIG = "--with-wmv --with-pcm --with-eac3 --with-dtsdownmix"

MACHINE_FEATURES += "nolcd AV_JACK"
```

## conf/machine/raspberrypi3.conf
```bitbake
#@TYPE: Machine
#@NAME: RaspberryPi 3 Development Board
#@DESCRIPTION: Machine configuration for the RaspberryPi 3

DEFAULTTUNE = "cortexa7thf-neon-vfpv4"

RPICHIPSET = "BCM2837"

require conf/machine/include/tune-cortexa7.inc
require conf/machine/include/rpi-base.inc

SDIMG_KERNELIMAGE = "kernel7.img"

SERIAL_CONSOLES = "115200;ttyS0"

# Check https://github.com/raspberrypi/firmware/tree/master/boot

RPI_KERNEL_DEVICETREE = "\
	bcm2710-rpi-3-b.dtb \
	bcm2710-rpi-3-b-plus.dtb \
	"

RPI_KERNEL_DEVICETREE_OVERLAYS += "\
	overlays/dwc-otg.dtbo \
	"

DVBMEDIASINK_CONFIG = "--with-wmv --with-pcm --with-eac3 --with-h265 --with-dtsdownmix"

MACHINE_FEATURES += "AV_JACK"
```

## conf/machine/raspberrypi4.conf
```bitbake
#@TYPE: Machine
#@NAME: RaspberryPi 4 Development Board
#@DESCRIPTION: Machine configuration for the RaspberryPi 4

DEFAULTTUNE = "cortexa7thf-neon-vfpv4"

RPICHIPSET = "BCM2711"

require conf/machine/include/tune-cortexa7.inc
require conf/machine/include/rpi-base.inc

# 'l' stands for LPAE
SDIMG_KERNELIMAGE = "kernel7l.img"

SERIAL_CONSOLES = "115200;ttyS0"

# Check https://github.com/raspberrypi/firmware/tree/master/boot

RPI_KERNEL_DEVICETREE = "\
	bcm2711-rpi-4-b.dtb \
	bcm2711-rpi-400.dtb \
	"

RPI_KERNEL_DEVICETREE_OVERLAYS += "\
	overlays/dwc-otg.dtbo \
	"

DVBMEDIASINK_CONFIG = "--with-wmv --with-pcm --with-eac3 --with-h265 --with-dtsdownmix"

MACHINE_FEATURES += "pci AV_JACK"
```
